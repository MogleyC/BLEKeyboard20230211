## CMakeLists.txt
```
cmake_minimum_required(VERSION 3.20.0)
find_package(Zephyr REQUIRED HINTS $ENV{ZEPHYR_BASE})

project(BLEKeyboard)

FILE(GLOB app_sources src/*.c)

target_sources(app PRIVATE ${app_sources})

zephyr_library_include_directories(.)
```

## prj.conf
```kconfig
# Kconfig Define Check Site
# https://developer.nordicsemi.com/nRF_Connect_SDK/doc/latest/kconfig/index.html#
# https://docs.zephyrproject.org/latest/kconfig.html

CONFIG_RTT_CONSOLE=y
CONFIG_USE_SEGGER_RTT=y
CONFIG_LOG_BACKEND_RTT=y
CONFIG_CONSOLE=y
CONFIG_LOG=y


CONFIG_BT=y
# CONFIG_BT_DEBUG_LOG=y	#is [DEPRECATED]
CONFIG_BT_MAX_CONN=2
CONFIG_BT_MAX_PAIRED=2
#Enable Secure Management Protocol (SMP) (required)
CONFIG_BT_SMP=y
CONFIG_BT_L2CAP_TX_BUF_COUNT=5
CONFIG_BT_PERIPHERAL=y
CONFIG_BT_DEVICE_NAME="KSG_HID_Keyboard"
# 961 -> Human Interface Device Keboard
CONFIG_BT_DEVICE_APPEARANCE=961

# Battery GATT Setting
# CONFIG_BT_BAS=y

# HID GATT Setting
CONFIG_BT_HIDS=y
CONFIG_BT_HIDS_MAX_CLIENT_COUNT=2

# HID RW encryption (enhanced security & increased power consumption)
CONFIG_BT_HIDS_DEFAULT_PERM_RW_ENCRYPT=y

# GATT UUID pool cnt
CONFIG_BT_GATT_UUID16_POOL_SIZE=40
# GATT Characteristic pool cnt
CONFIG_BT_GATT_CHRC_POOL_SIZE=20
# Connect Context Enable - connect info save
CONFIG_BT_CONN_CTX=y

# Chipset information notation
CONFIG_BT_DIS=y
CONFIG_BT_DIS_PNP=y
CONFIG_BT_DIS_MANUF="NordicSemiconductor"
CONFIG_BT_DIS_PNP_VID_SRC=2
CONFIG_BT_DIS_PNP_VID=0x1915
CONFIG_BT_DIS_PNP_PID=0xEEEF
CONFIG_BT_DIS_PNP_VER=0x0100

# System task stack size
CONFIG_SYSTEM_WORKQUEUE_STACK_SIZE=2048

# Save various BT settings to FLASH
CONFIG_BT_SETTINGS=y
CONFIG_FLASH=y
CONFIG_FLASH_PAGE_LAYOUT=y
CONFIG_FLASH_MAP=y
CONFIG_NVS=y
CONFIG_SETTINGS=y
```

## src/main.c
```c
// APIs Search Site
// https://docs.zephyrproject.org/apidoc/latest/index.html

#include "include.h"
#include <zephyr/drivers/gpio.h>

#include "BleHidKeyboard.h"
#include "gpio.h"

LOG_MODULE_REGISTER(my_module, LOG_LEVEL_INF);

int main(void)
{
	int ret;
	printk("[main] Start\n");

	ret = gpio_init();
	if (ret < 0)
	{
		printk("[gpio_init] failed\n");
		return -1;
	}
	
	ret = gpio_thread_start();
	if (ret < 0)
	{
		printk("[gpio_thread_start] failed\n");
		return -1;
	}

	ret = bleHid_init();
	if (ret < 0)
	{
		printk("[bleHid_init] failed\n");
		return -1;
	}
	
	ret = bleHid_thread_start();
	if (ret < 0)
	{
		printk("[bleHid_thread_start] failed\n");
		return -1;
	}

	printk("[main] Loop STD\n");
	
	while (1)
	{
		k_msleep(1000);
	}
	return 0;
}
```

## src/BleHidKeyboard.c
```c
#if 1

#include "BleHidKeyboard.h"

#include <zephyr/shell/shell.h>

#include <zephyr/types.h>
#include <stddef.h>
#include <string.h>
#include <errno.h>
#include <zephyr/sys/printk.h>
#include <zephyr/sys/byteorder.h>
#include <zephyr/kernel.h>
#include <zephyr/drivers/gpio.h>
#include <soc.h>
#include <assert.h>
#include <zephyr/spinlock.h>

#include <zephyr/settings/settings.h>

#include <zephyr/bluetooth/bluetooth.h>
#include <zephyr/bluetooth/hci.h>
#include <zephyr/bluetooth/conn.h>
#include <zephyr/bluetooth/uuid.h>
#include <zephyr/bluetooth/gatt.h>

#include <zephyr/bluetooth/services/bas.h>
#include <bluetooth/services/hids.h>
#include <zephyr/bluetooth/services/dis.h>

#include "gpio.h"
#include "hid_usages.h"
#include "bleProfile_HidKeyboard_0.h"
#include "bleProfile_HidKeyboard_1.h"



// for logging
LOG_MODULE_DECLARE(my_module);

// for thread
K_THREAD_STACK_DEFINE(thread_stack_area_blehid_0, 1024);
static struct k_thread thread_data_blehid_0;

#define DEVICE_NAME     CONFIG_BT_DEVICE_NAME
#define DEVICE_NAME_LEN (sizeof(DEVICE_NAME) - 1)

/* ********************* */


static volatile bool is_adv;
static volatile bool is_BLEConnected = false;

static const struct bt_data ad[] = {
	BT_DATA_BYTES(BT_DATA_GAP_APPEARANCE,
				  (CONFIG_BT_DEVICE_APPEARANCE >> 0) & 0xff,
				  (CONFIG_BT_DEVICE_APPEARANCE >> 8) & 0xff),
	BT_DATA_BYTES(BT_DATA_FLAGS, (BT_LE_AD_GENERAL | BT_LE_AD_NO_BREDR)),
	BT_DATA_BYTES(BT_DATA_UUID16_ALL, BT_UUID_16_ENCODE(BT_UUID_HIDS_VAL),
				  BT_UUID_16_ENCODE(BT_UUID_BAS_VAL)),
};

static const struct bt_data sd[] = {
	BT_DATA(BT_DATA_NAME_COMPLETE, DEVICE_NAME, DEVICE_NAME_LEN),
};

struct pairing_data_mitm
{
	struct bt_conn *conn;
	unsigned int passkey;
};

K_MSGQ_DEFINE(mitm_queue,
			  sizeof(struct pairing_data_mitm),
			  CONFIG_BT_HIDS_MAX_CLIENT_COUNT,
			  4);


#define ISKEYPRESS_SIZE 16	// = col:4 * row:4
#define KEYS_STATE_SIZE KEY_PRESS_MAX
#define KEYPRESS_LMITE KEY_PRESS_MAX * 2
static bool isKeyPress[ISKEYPRESS_SIZE] = {0};
static bool isKeyPressPrev[ISKEYPRESS_SIZE] = {0};
static struct keyboard_state kb_state[2];

static void setPairingConfirm(bool accept);

static void advertising_start(void)
{
	int err;
	struct bt_le_adv_param *adv_param = BT_LE_ADV_PARAM(
		BT_LE_ADV_OPT_CONNECTABLE |
			BT_LE_ADV_OPT_ONE_TIME,
		BT_GAP_ADV_FAST_INT_MIN_2,
		BT_GAP_ADV_FAST_INT_MAX_2,
		NULL);

	err = bt_le_adv_start(adv_param, ad, ARRAY_SIZE(ad), sd,
						  ARRAY_SIZE(sd));
	if (err)
	{
		if (err == -EALREADY)
		{
			printk("Advertising continued\n");
		}
		else
		{
			printk("Advertising failed to start (err %d)\n", err);
		}

		return;
	}

	is_adv = true;
	printk("Advertising successfully started\n");
}

static void connected(struct bt_conn *conn, uint8_t err)
{
	char addr[BT_ADDR_LE_STR_LEN];

	bt_addr_le_to_str(bt_conn_get_dst(conn), addr, sizeof(addr));

	if (err)
	{
		printk("Failed to connect to %s (%u)\n", addr, err);
		return;
	}

	printk("Connected %s\n", addr);

	err = hid_kb_0_set_connected(conn);
	err = hid_kb_1_set_connected(conn);
	
	is_adv = false;
	is_BLEConnected = true;
}

static void disconnected(struct bt_conn *conn, uint8_t reason)
{
	int err;
	char addr[BT_ADDR_LE_STR_LEN];

	bt_addr_le_to_str(bt_conn_get_dst(conn), addr, sizeof(addr));

	printk("Disconnected from %s (reason %u)\n", addr, reason);

	err = hid_kb_0_set_disconnected(conn);
	err = hid_kb_1_set_disconnected(conn);

	is_BLEConnected = false;
	advertising_start();
}

static void security_changed(struct bt_conn *conn, bt_security_t level,
							 enum bt_security_err err)
{
	char addr[BT_ADDR_LE_STR_LEN];

	bt_addr_le_to_str(bt_conn_get_dst(conn), addr, sizeof(addr));

	if (!err)
	{
		printk("Security changed: %s level %u\n", addr, level);
	}
	else
	{
		printk("Security failed: %s level %u err %d\n", addr, level,
			   err);
	}
}

BT_CONN_CB_DEFINE(conn_callbacks) = {
	.connected = connected,
	.disconnected = disconnected,
	.security_changed = security_changed,
};

static void auth_passkey_display(struct bt_conn *conn, unsigned int passkey)
{
	char addr[BT_ADDR_LE_STR_LEN];

	bt_addr_le_to_str(bt_conn_get_dst(conn), addr, sizeof(addr));

	printk("Passkey for %s: %06u\n", addr, passkey);
}

/// @brief 페어링인증 중 유저에게 패스키 확인 요청
/// @param conn 페어링 요청한 기기 정보
/// @param passkey 페어링 요청 키
static void auth_passkey_confirm(struct bt_conn *conn, unsigned int passkey)
{
	int err;

	struct pairing_data_mitm pairing_data;
	
	pairing_data.conn = bt_conn_ref(conn);		// 불루투스 연결객체의 참조 카운트를 증가 (pairing_data.conn == conn 같은 주소값이다.)
	pairing_data.passkey = passkey;				// passkey를 프린트할때 사용한다.

	// 페어링 요청 정보를 mitm_queue에 저장
	// mitm_queue의 size만큼만 저장된다.(defualt = 1 = CONFIG_BT_HIDS_MAX_CLIENT_COUNT)
	err = k_msgq_put(&mitm_queue, &pairing_data, K_NO_WAIT);
	if (err)
	{
		printk("Pairing queue is full. Purge previous data.\n");
	}

	// 현재 받은 정보로 요청을 수락한다.
	// (즉, 제일 먼저 온 기기에 대해 곧바로 수락한다.)
	// (요청 수락을 선택적으로 하려면 이 부분의 수정이 필요하다.)
	setPairingConfirm(true);
}

/// @brief 취소된 장치의 주소를 받아 터미널에 출력한다.
/// @param conn 
static void auth_cancel(struct bt_conn *conn)
{
	char addr[BT_ADDR_LE_STR_LEN];
	bt_addr_le_to_str(bt_conn_get_dst(conn), addr, sizeof(addr));
	printk("Pairing cancelled: %s\n", addr);
}

static void pairing_complete(struct bt_conn *conn, bool bonded)
{
	char addr[BT_ADDR_LE_STR_LEN];

	bt_addr_le_to_str(bt_conn_get_dst(conn), addr, sizeof(addr));

	printk("Pairing completed: %s, bonded: %d\n", addr, bonded);
}

static void pairing_failed(struct bt_conn *conn, enum bt_security_err reason)
{
	char addr[BT_ADDR_LE_STR_LEN];
	struct pairing_data_mitm pairing_data;

	if (k_msgq_peek(&mitm_queue, &pairing_data) != 0)
	{
		return;
	}

	if (pairing_data.conn == conn)
	{
		bt_conn_unref(pairing_data.conn);
		k_msgq_get(&mitm_queue, &pairing_data, K_NO_WAIT);
	}

	bt_addr_le_to_str(bt_conn_get_dst(conn), addr, sizeof(addr));

	printk("Pairing failed conn: %s, reason %d\n", addr, reason);
}

static struct bt_conn_auth_cb conn_auth_callbacks = {
	.passkey_display = auth_passkey_display,
	.passkey_confirm = auth_passkey_confirm,
	.cancel = auth_cancel,
#if CONFIG_NFC_OOB_PAIRING
	.oob_data_request = auth_oob_data_request,
#endif
};

static struct bt_conn_auth_info_cb conn_auth_info_callbacks = {
	.pairing_complete = pairing_complete,
	.pairing_failed = pairing_failed};

/// @brief 인증을 수락/취소 한다.
/// @param accept 
static void setPairingConfirm(bool accept)
{
	struct pairing_data_mitm pairing_data;
	struct bt_conn *conn;

	// 인증관련정보(메시지)가 존재하는지 확인
	if (k_msgq_get(&mitm_queue, &pairing_data, K_NO_WAIT) != 0)
	{
		return;
	}

	conn = pairing_data.conn;

	if (accept)
	{
		bt_conn_auth_passkey_confirm(conn);
		printk("Pairing Confirm accept, conn %p\n", conn);
	}
	else
	{
		bt_conn_auth_cancel(conn);
		printk("Pairing Confirm Reject, conn %p\n", conn);
	}

	// 불루투스 연결객체의 참조 카운트를 감소
	bt_conn_unref(pairing_data.conn);
}

static uint8_t getBtnIDtoHidUsages(uint8_t swID)
{
	switch (swID)
	{
	case 0:
		return HID_KEY_KP0;
		break;
	case 1:
		return HID_KEY_KPDOT;
		break;
	case 2:
		return HID_KEY_KPASTERISK;
		break;
	case 3:
		return HID_KEY_KPENTER;
		break;

	case 4:
		return HID_KEY_KP1;
		break;
	case 5:
		return HID_KEY_KP2;
		break;
	case 6:
		return HID_KEY_KP3;
		break;
	case 7:
		return HID_KEY_KPPLUS;
		break;

	case 8:
		return HID_KEY_KP4;
		break;
	case 9:
		return HID_KEY_KP5;
		break;
	case 10:
		return HID_KEY_KP6;
		break;
	case 11:
		return HID_KEY_KPMINUS;
		break;

	case 12:
		return HID_KEY_KP7;
		break;
	case 13:
		return HID_KEY_KP8;
		break;
	case 14:
		return HID_KEY_KP9;
		break;
	case 15:
		return HID_KEY_NUMLOCK;
		break;

	default:
		return HID_KEY_NONE;
		break;
	}

	return HID_KEY_NONE;
}

struct keyQue_t
{
	uint8_t id_fornt;
	uint8_t id_back;
	uint8_t data[0xFF + 1];

} typedef keyQue;

static keyQue keyQue_add;
static keyQue keyQue_remove;

static int keyQue_put(keyQue * keyQue_ptr, uint8_t key_usageVal)
{
	if(keyQue_ptr->id_fornt == keyQue_ptr->id_back + 1)
	{
		printk("[keyQue_put] err. Queue size is full\n");
		return RESERT_ERR;
	}

	keyQue_ptr->data[keyQue_ptr->id_back] = key_usageVal;
	// printk("[keyQue_put] data[%d] %d\n", keyQue_ptr->id_back, keyQue_ptr->data[keyQue_ptr->id_back]);
	++(keyQue_ptr->id_back);

	return RESERT_OK;
}

static int keyQue_pop(keyQue *keyQue_ptr, uint8_t *p_out_key_usageVal)
{
	if (keyQue_ptr->id_fornt == keyQue_ptr->id_back)
	{
		// printk("[keyQue_pop] err. No more pop data\n");
		return RESERT_ERR;
	}

	*p_out_key_usageVal = keyQue_ptr->data[keyQue_ptr->id_fornt];
	// printk("[keyQue_pop] data[%d] %d\n", keyQue_ptr->id_fornt, keyQue_ptr->data[keyQue_ptr->id_fornt]);
	++(keyQue_ptr->id_fornt);

	return RESERT_OK;
}

static uint8_t keyQue_getSize(const keyQue * keyQue_ptr)
{
	return (keyQue_ptr->id_back - keyQue_ptr->id_fornt);
}

static void keyQue_reset(keyQue * keyQue_ptr)
{
	memset(keyQue_ptr, 0, sizeof(keyQue));
}

static void thread_keyCheck(void *arg1, void *arg2, void *arg3)
{
    // arg1, arg2, arg3 사용하지 않음을 명시
    (void)arg1;
    (void)arg2;
    (void)arg3;

	int ret = 0;
	struct k_msgq * key_status_msg_queue_ptr = get_key_status_msg_queue_ptr();
	int i, j;

	while (true)
	{
		if(is_BLEConnected == false)
		{
			// Key Buffer reset
			{
				memset(isKeyPress, 0, ISKEYPRESS_SIZE);
				memset(isKeyPressPrev, 0, ISKEYPRESS_SIZE);
				memset(kb_state, 0, sizeof(kb_state));
				keyQue_reset(&keyQue_add);
				keyQue_reset(&keyQue_remove);
			}

			// 연결 되기까지 대기
			while (is_BLEConnected == false)
			{
				k_msleep(10);
				continue;
			}
			
		}
		
		memset(isKeyPress, 0, ISKEYPRESS_SIZE);
		for (i = 0; i < 4; i++)
		{
			// 메시지 수신
			key_status_msg_data msg_data;
			ret = k_msgq_get(key_status_msg_queue_ptr, &msg_data, K_FOREVER);
			if (ret != RESERT_OK)
			{
				printk("Err. [thread_keyCheck] k_msgq_get\n");
				continue;
			}
			memcpy(&isKeyPress[msg_data.rowIdx * 4], msg_data.colKeyInput, sizeof(msg_data.colKeyInput));
		}

		// for (i = 3; i >= 0; --i)
		// {
		// 	printk("[%d] %d %d %d %d\n", i, isKeyPress[i * 4 + 0], isKeyPress[i * 4 + 1], isKeyPress[i * 4 + 2], isKeyPress[i * 4 + 3]);
		// }

		// check key change
		for (i = 0; i < ISKEYPRESS_SIZE; i++)
		{
			if(isKeyPress[i] != isKeyPressPrev[i])
			{
				if(isKeyPress[i] == true)
				{
					// 큐 추가 : 새로운 키 추가 입력
					printk("[keyQue_add] %d\n", getBtnIDtoHidUsages(i));
					keyQue_put(&keyQue_add, getBtnIDtoHidUsages(i));
				}
				else{
					// 큐 추가 : 기존 키 삭제
					printk("[keyQue_remove] %d\n", getBtnIDtoHidUsages(i));
					keyQue_put(&keyQue_remove, getBtnIDtoHidUsages(i));
				}
			}
		}

		// KeyPressPrev update
		memcpy(isKeyPressPrev, isKeyPress, ISKEYPRESS_SIZE);
		if (keyQue_getSize(&keyQue_add) > 0 || keyQue_getSize(&keyQue_remove) > 0)
		{
			bool isOver = false;
			uint8_t key_usageVal;
			bool isChanged[2];
			memset(isChanged, 0, sizeof(isChanged));
			
			// printk("[keyQue_szie] add:%d remove:%d\n", keyQue_getSize(&keyQue_add), keyQue_getSize(&keyQue_remove));

			// 기존 키 삭제
			while (keyQue_pop(&keyQue_remove, &key_usageVal) == RESERT_OK)
			{
				isOver = false;

				for (i = 0; !isOver && i < 2; i++)
				{
					for (j = 0; !isOver && j < KEYS_STATE_SIZE; j++)
					{
						if (kb_state[i].keys_state[j] == key_usageVal)
						{
							// printk("[keyQue_remove] kb_state[%d].keys_state[%d] = key_usageVal:%d\n", i, j, key_usageVal);
							kb_state[i].keys_state[j] = HID_KEY_NONE;
							isOver = true;
							isChanged[i] = true;
							break;
						}
					}
				}
			}

			// 새로운 키 추가 입력
			while (keyQue_pop(&keyQue_add, &key_usageVal) == RESERT_OK)
			{
				isOver = false;

				for (i = 0; !isOver && i < 2; i++)
				{
					for (j = 0; !isOver && j < KEYS_STATE_SIZE; j++)
					{
						if (kb_state[i].keys_state[j] == HID_KEY_NONE)
						{
							// printk("[keyQue_add] kb_state[%d].keys_state[%d] = key_usageVal:%d\n", i, j, key_usageVal);
							kb_state[i].keys_state[j] = key_usageVal;
							isOver = true;
							isChanged[i] = true;
							break;
						}
					}
				}
			}

			// msg send
			// printk("[hid_kb_x_key_report_send] isChanged[0]:%d isChanged[1]:%d\n", isChanged[0], isChanged[1]);
			if (isChanged[0] == true)
			{
				hid_kb_0_key_report_send(&kb_state[0]);
			}
			if (isChanged[1] == true)
			{
				hid_kb_1_key_report_send(&kb_state[1]);
			}
		}
	}
}

int bleHid_init(void)
{
	int err;

	// 페어링 보안인증 확인/시도/취소 콜백 등록 - null로 설정시 보안 설정 안함
	err = bt_conn_auth_cb_register(&conn_auth_callbacks);
	// err = bt_conn_auth_cb_register(NULL);
	if (err)
	{
		printk("Failed to register authorization callbacks.\n");
		return 0;
	}

	// 페어링 보안인증 성공/실패 콜백 등록
	err = bt_conn_auth_info_cb_register(&conn_auth_info_callbacks);
	if (err)
	{
		printk("Failed to register authorization info callbacks.\n");
		return 0;
	}

	// hid 프로토콜 설정
	err = hid_kb_0_init();
	if (err)
	{
		printk("hid_kb_0_init failed (err %d)\n", err);
		return 0;
	}

	err = hid_kb_1_init();
	if (err)
	{
		printk("hid_kb_1_init failed (err %d)\n", err);
		return 0;
	}

	err = bt_enable(NULL);
	printk("Bluetooth init (err %d)\n", err);
	if (err)
	{
		printk("Bluetooth init failed (err %d)\n", err);
		return 0;
	}

	printk("Bluetooth initialized\n");

	// Flash에서 저장된 내용 불러오기
	// CONFIG_BT_SETTINGS에 의해 페어링 키 등을 불러옴
	if (IS_ENABLED(CONFIG_SETTINGS))
	{
		settings_load();
	}

	advertising_start();

	return 0;
}

int bleHid_thread_start(void)
{
	k_thread_create(&thread_data_blehid_0, thread_stack_area_blehid_0,
					K_THREAD_STACK_SIZEOF(thread_stack_area_blehid_0),
					thread_keyCheck,
					NULL, NULL, NULL,
					7, 0, K_NO_WAIT);

	 k_thread_start(&thread_data_blehid_0);
	 
	return 0;
}

#endif
```

## src/BleHidKeyboard.h
```c
#ifndef BLEHIDKEYBOARD_H
#define BLEHIDKEYBOARD_H

#include "include.h"

int bleHid_init(void);
int bleHid_thread_start(void);

#endif
```

## src/bleProfile_HidKeyboard_0.c
```c
#include "bleProfile_HidKeyboard_0.h"

#define HID_OBJ hids_obj_0

/* HIDS instance. */
BT_HIDS_DEF(HID_OBJ,
			OUTPUT_REPORT_MAX_LEN,
			INPUT_REPORT_KEYS_MAX_LEN);

static struct conn_mode conn_mode[CONFIG_BT_HIDS_MAX_CLIENT_COUNT];

static void hids_pm_evt_handler(enum bt_hids_pm_evt evt,
								struct bt_conn *conn)
{
	hid_kb_hids_pm_evt_handler(conn_mode, evt, conn);
}

int hid_kb_0_init(void)
{
	return hid_kb_init(&HID_OBJ, hids_pm_evt_handler);
}

int hid_kb_0_set_connected(struct bt_conn *conn)
{
	return hid_kb_set_connected(&HID_OBJ, conn_mode, conn);
}

int hid_kb_0_set_disconnected(struct bt_conn *conn)
{
	return hid_kb_set_disconnected(&HID_OBJ, conn_mode, conn);
}

int hid_kb_0_key_report_send(const struct keyboard_state *state)
{
	return hid_kb_key_report_send(&HID_OBJ, conn_mode, state);
}
```

## src/bleProfile_HidKeyboard_0.h
```c
#ifndef BLEPROFILE_HIDKEYBOARD_0_H
#define BLEPROFILE_HIDKEYBOARD_0_H

#include "include.h"
#include "bleProfile_HidKeyboard_def.h"

int hid_kb_0_init(void);
int hid_kb_0_set_connected(struct bt_conn *conn);
int hid_kb_0_set_disconnected(struct bt_conn *conn);
int hid_kb_0_key_report_send(const struct keyboard_state *state);

#endif
```

## src/bleProfile_HidKeyboard_1.c
```c
#include "bleProfile_HidKeyboard_1.h"

#define HID_OBJ hids_obj_1

/* HIDS instance. */
BT_HIDS_DEF(HID_OBJ,
			OUTPUT_REPORT_MAX_LEN,
			INPUT_REPORT_KEYS_MAX_LEN);

static struct conn_mode conn_mode[CONFIG_BT_HIDS_MAX_CLIENT_COUNT];

static void hids_pm_evt_handler(enum bt_hids_pm_evt evt,
								struct bt_conn *conn)
{
	hid_kb_hids_pm_evt_handler(conn_mode, evt, conn);
}

int hid_kb_1_init(void)
{
	return hid_kb_init(&HID_OBJ, hids_pm_evt_handler);
}

int hid_kb_1_set_connected(struct bt_conn *conn)
{
	return hid_kb_set_connected(&HID_OBJ, conn_mode, conn);
}

int hid_kb_1_set_disconnected(struct bt_conn *conn)
{
	return hid_kb_set_disconnected(&HID_OBJ, conn_mode, conn);
}

int hid_kb_1_key_report_send(const struct keyboard_state *state)
{
	return hid_kb_key_report_send(&HID_OBJ, conn_mode, state);
}
```

## src/bleProfile_HidKeyboard_1.h
```c
#ifndef BLEPROFILE_HIDKEYBOARD_1_H
#define BLEPROFILE_HIDKEYBOARD_1_H

#include "include.h"
#include "bleProfile_HidKeyboard_def.h"

int hid_kb_1_init(void);
int hid_kb_1_set_connected(struct bt_conn *conn);
int hid_kb_1_set_disconnected(struct bt_conn *conn);
int hid_kb_1_key_report_send(const struct keyboard_state *state);

#endif
```

## src/bleProfile_HidKeyboard_def.c
```c
#include "bleProfile_HidKeyboard_def.h"

#include "gpio.h"

/**
 * @brief led(CAPSLOCK/NUMLOCK 등) 상태를 표출
 *
 */
static void led_handler(const struct bt_hids_rep *rep)
{
	{

		LEDstatus report_val = ((*rep->data) & OUTPUT_REPORT_BIT_MASK_NUM_LOCK) ? LEDstatus_isOn : LEDstatus_isOff;
		gpio_setStatusLed(report_val);
		// printk("[led_handler] NUM_LOCK:%d\n", report_val);
	}

	// {
	// 	uint8_t report_val = ((*rep->data) & OUTPUT_REPORT_BIT_MASK_CAPS_LOCK) ? 1 : 0;
	// 	printk("[led_handler] CAPS_LOCK:%d\n", report_val);
	// }
}

static void hids_outp_rep_handler(struct bt_hids_rep *rep,
								  struct bt_conn *conn,
								  bool write)
{
	if (!write)
	{
		printk("Output report read\n");
		return;
	};

	// char addr[BT_ADDR_LE_STR_LEN];
	// bt_addr_le_to_str(bt_conn_get_dst(conn), addr, sizeof(addr));
	// printk("Output report has been received %s\n", addr);
	led_handler(rep);
}

/**
 * @brief 부트모드에서 키보드 출력보고서 전송시 호출
 */
static void hids_boot_kb_outp_rep_handler(struct bt_hids_rep *rep,
										  struct bt_conn *conn,
										  bool write)
{
	char addr[BT_ADDR_LE_STR_LEN];

	if (!write)
	{
		printk("Output report read\n");
		return;
	};

	bt_addr_le_to_str(bt_conn_get_dst(conn), addr, sizeof(addr));
	printk("Boot Keyboard Output report has been received %s\n", addr);
	led_handler(rep);
}

void hid_kb_hids_pm_evt_handler(struct conn_mode *conn_mode,
									   enum bt_hids_pm_evt evt,
									   struct bt_conn *conn)
{
	char addr[BT_ADDR_LE_STR_LEN];
	size_t i;

	for (i = 0; i < CONFIG_BT_HIDS_MAX_CLIENT_COUNT; i++)
	{
		if (conn_mode[i].conn == conn)
		{
			break;
		}
	}

	if (i >= CONFIG_BT_HIDS_MAX_CLIENT_COUNT)
	{
		printk("Cannot find connection handle when processing PM");
		return;
	}

	bt_addr_le_to_str(bt_conn_get_dst(conn), addr, sizeof(addr));

	switch (evt)
	{
	case BT_HIDS_PM_EVT_BOOT_MODE_ENTERED:
		printk("Boot mode entered %s\n", addr);
		conn_mode[i].in_boot_mode = true;
		break;

	case BT_HIDS_PM_EVT_REPORT_MODE_ENTERED:
		printk("Report mode entered %s\n", addr);
		conn_mode[i].in_boot_mode = false;
		break;

	default:
		break;
	}
}

/** @brief Function process keyboard state and sends it
 *
 *  @param pstate     The state to be sent
 *  @param boot_mode  Information if boot mode protocol is selected.
 *  @param conn       Connection handler
 *
 *  @return 0 on success or negative error code.
 */
static int key_report_con_send(struct bt_hids *hids_obj,
									  const struct keyboard_state *state,
									  bool boot_mode,
									  struct bt_conn *conn)
{
	int err = 0;
	uint8_t data[INPUT_REPORT_KEYS_MAX_LEN];

	memset(data, 0, sizeof(data));

	// 특수키
	// data[0] = state->ctrl_keys_state;
	// data[1] = 0;

	// 일반 6키
	memcpy(&data[2], state->keys_state, KEY_PRESS_MAX);
	// printk("[state->keys_state[0] 1] %d\n", state->keys_state[0]);
	// if (state->keys_state[0] != HID_KEY_NONE)
	// {
	// 	data[2] = HID_KEY_2;
	// 	data[3] = HID_KEY_3;
	// 	data[4] = HID_KEY_4;
	// 	data[5] = HID_KEY_5;
	// 	data[6] = HID_KEY_6;
	// 	data[7] = HID_KEY_7;
	// 	data[8] = HID_KEY_8;
	// 	data[9] = HID_KEY_9;
	// }

	if (boot_mode)
	{
		err = bt_hids_boot_kb_inp_rep_send(hids_obj, conn, data,
										   sizeof(data), NULL);
	}
	else
	{
		err = bt_hids_inp_rep_send(hids_obj, conn,
								   INPUT_REP_KEYS_IDX, data,
								   sizeof(data), NULL);
	}
	return err;
}

int hid_kb_init(struct bt_hids *hids_obj, bt_hids_pm_evt_handler_t pm_evt_handler)
{
	int err;
	struct bt_hids_init_param hids_init_obj = {0};
	struct bt_hids_inp_rep *hids_inp_rep;
	struct bt_hids_outp_feat_rep *hids_outp_rep;

	static const uint8_t report_map[] = {
		0x05, 0x01, /* Usage Page (Generic Desktop) */
		0x09, 0x06, /* Usage (Keyboard) */
		0xA1, 0x01, /* Collection (Application) */

/* Keys */
#if INPUT_REP_KEYS_REF_ID
		0x85, INPUT_REP_KEYS_REF_ID,
#endif
		0x05, 0x07, /* Usage Page (Key Codes) */
		0x19, 0xe0, /* Usage Minimum (224) */
		0x29, 0xe7, /* Usage Maximum (231) */
		0x15, 0x00, /* Logical Minimum (0) */
		0x25, 0x01, /* Logical Maximum (1) */
		0x75, 0x01, /* Report Size (1) */
		0x95, 0x08, /* Report Count (8) */
		0x81, 0x02, /* Input (Data, Variable, Absolute) */

		0x95, 0x01, /* Report Count (1) */
		0x75, 0x08, /* Report Size (8) */
		0x81, 0x01, /* Input (Constant) reserved byte(1) */

		// 0x95, 0x06, /* Report Count (6) */
		0x95, KEY_PRESS_MAX, /* Report Count (x) */
		0x75, 0x08, /* Report Size (8) */
		0x15, 0x00, /* Logical Minimum (0) */
		0x25, 0x65, /* Logical Maximum (101) */
		0x05, 0x07, /* Usage Page (Key codes) */
		0x19, 0x00, /* Usage Minimum (0) */
		0x29, 0x65, /* Usage Maximum (101) */
		0x81, 0x00, /* Input (Data, Array) Key array(6 bytes) */

/* LED */
#if OUTPUT_REP_KEYS_REF_ID
		0x85, OUTPUT_REP_KEYS_REF_ID,
#endif
		0x95, 0x05, /* Report Count (5) */
		0x75, 0x01, /* Report Size (1) */
		0x05, 0x08, /* Usage Page (Page# for LEDs) */
		0x19, 0x01, /* Usage Minimum (1) */
		0x29, 0x05, /* Usage Maximum (5) */
		0x91, 0x02, /* Output (Data, Variable, Absolute), */
		/* Led report */
		0x95, 0x01, /* Report Count (1) */
		0x75, 0x03, /* Report Size (3) */
		0x91, 0x01, /* Output (Data, Variable, Absolute), */
		/* Led report padding */

		0xC0 /* End Collection (Application) */
	};

	hids_init_obj.rep_map.data = report_map;
	hids_init_obj.rep_map.size = sizeof(report_map);

	hids_init_obj.info.bcd_hid = BASE_USB_HID_SPEC_VERSION;
	hids_init_obj.info.b_country_code = 0x00;
	hids_init_obj.info.flags = (BT_HIDS_REMOTE_WAKE |
								BT_HIDS_NORMALLY_CONNECTABLE);

	hids_inp_rep =
		&hids_init_obj.inp_rep_group_init.reports[INPUT_REP_KEYS_IDX];
	hids_inp_rep->size = INPUT_REPORT_KEYS_MAX_LEN;
	hids_inp_rep->id = INPUT_REP_KEYS_REF_ID;
	hids_init_obj.inp_rep_group_init.cnt++;

	hids_outp_rep =
		&hids_init_obj.outp_rep_group_init.reports[OUTPUT_REP_KEYS_IDX];
	hids_outp_rep->size = OUTPUT_REPORT_MAX_LEN;
	hids_outp_rep->id = OUTPUT_REP_KEYS_REF_ID;
	hids_outp_rep->handler = hids_outp_rep_handler;
	hids_init_obj.outp_rep_group_init.cnt++;

	hids_init_obj.is_kb = true;
	hids_init_obj.boot_kb_outp_rep_handler = hids_boot_kb_outp_rep_handler;
	hids_init_obj.pm_evt_handler = pm_evt_handler;

	err = bt_hids_init(hids_obj, &hids_init_obj);
	__ASSERT(err == 0, "HIDS initialization failed\n");

	return err;
}

int hid_kb_set_connected(struct bt_hids *hids_obj,
						 struct conn_mode *conn_mode,
						 struct bt_conn *conn)
{
	int err = bt_hids_connected(hids_obj, conn);

	if (err)
	{
		printk("Failed to notify HID service about connection\n");
		return err;
	}

	for (size_t i = 0; i < CONFIG_BT_HIDS_MAX_CLIENT_COUNT; i++)
	{
		if (!conn_mode[i].conn)
		{
			conn_mode[i].conn = conn;
			conn_mode[i].in_boot_mode = false;
			break;
		}
	}

	gpio_setStatusLed(LEDstatus_isOn);

	return err;
}

int hid_kb_set_disconnected(struct bt_hids *hids_obj,
							struct conn_mode *conn_mode,
							struct bt_conn *conn)
{
	int err = bt_hids_disconnected(hids_obj, conn);

	if (err)
	{
		printk("Failed to notify HID service about disconnection\n");
	}

	for (size_t i = 0; i < CONFIG_BT_HIDS_MAX_CLIENT_COUNT; i++)
	{
		if (conn_mode[i].conn == conn)
		{
			conn_mode[i].conn = NULL;
		}
	}

	gpio_setStatusLed(LEDstatus_isBlink);

	return err;
}

int hid_kb_key_report_send(struct bt_hids *hids_obj,
						   struct conn_mode *conn_mode,
						   const struct keyboard_state *state)
{
	for (size_t i = 0; i < CONFIG_BT_HIDS_MAX_CLIENT_COUNT; i++)
	{
		if (conn_mode[i].conn)
		{
			int err;

			err = key_report_con_send(hids_obj,
									  state,
									  conn_mode[i].in_boot_mode,
									  conn_mode[i].conn);
			if (err)
			{
				printk("Key report send error: %d\n", err);
				return err;
			}
		}
	}
	return 0;
}
```

## src/bleProfile_HidKeyboard_def.h
```c
#ifndef BLEPROFILE_HIDKEYBOARD_DEF_H
#define BLEPROFILE_HIDKEYBOARD_DEF_H

#include <bluetooth/services/hids.h>
#include "hid_usages.h"

#define BASE_USB_HID_SPEC_VERSION 0x0101

#define OUTPUT_REPORT_MAX_LEN 1
#define OUTPUT_REPORT_BIT_MASK_NUM_LOCK 0x01
#define OUTPUT_REPORT_BIT_MASK_CAPS_LOCK 0x02
#define INPUT_REP_KEYS_REF_ID 0
#define OUTPUT_REP_KEYS_REF_ID 0
#define SCAN_CODE_POS 2

/* Buttons configuration */

/* Note: The configuration below is the same as BOOT mode configuration
 * This simplifies the code as the BOOT mode is the same as REPORT mode.
 * Changing this configuration would require separate implementation of
 * BOOT mode report generation.
 */
#define KEY_CTRL_CODE_MIN 224 /* Control key codes - required 8 of them */
#define KEY_CTRL_CODE_MAX 231 /* Control key codes - required 8 of them */
#define KEY_CODE_MIN 0		  /* Normal key codes */
#define KEY_CODE_MAX 101	  /* Normal key codes */
#define KEY_PRESS_MAX 8		  /* Maximum number of non-control keys \
							   * pressed simultaneously             \
							   * default 6							\
							   */

/* Number of bytes in key report
 *
 * 1B - control keys
 * 1B - reserved
 * rest - non-control keys
 */
#define INPUT_REPORT_KEYS_MAX_LEN (1 + 1 + KEY_PRESS_MAX)

/* Current report map construction requires exactly 8 buttons */
BUILD_ASSERT((KEY_CTRL_CODE_MAX - KEY_CTRL_CODE_MIN) + 1 == 8);

/* OUT report internal indexes.
 *
 * This is a position in internal report table and is not related to
 * report ID.
 */
enum
{
	OUTPUT_REP_KEYS_IDX = 0
};

/* INPUT report internal indexes.
 *
 * This is a position in internal report table and is not related to
 * report ID.
 */
enum
{
	INPUT_REP_KEYS_IDX = 0
};

struct conn_mode
{
	struct bt_conn *conn;
	bool in_boot_mode;
};

struct keyboard_state
{
	uint8_t ctrl_keys_state; /* Current keys state */
	uint8_t keys_state[KEY_PRESS_MAX];
};

void hid_kb_hids_pm_evt_handler(struct conn_mode *conn_mode,
									   enum bt_hids_pm_evt evt,
									   struct bt_conn *conn);

int hid_kb_init(struct bt_hids *hids_obj, bt_hids_pm_evt_handler_t pm_evt_handler);

int hid_kb_set_connected(struct bt_hids *hids_obj,
						 struct conn_mode *conn_mode,
						 struct bt_conn *conn);

int hid_kb_set_disconnected(struct bt_hids *hids_obj,
							struct conn_mode *conn_mode,
							struct bt_conn *conn);

/** @brief Function process and send keyboard state to all active connections
 *
 * Function process global keyboard state and send it to all connected
 * clients.
 *
 * @return 0 on success or negative error code.
 */
int hid_kb_key_report_send(struct bt_hids *hids_obj,
						   struct conn_mode *conn_mode,
						   const struct keyboard_state *state);

#endif
```

## src/gpio.c
```c
/**
 * @file gpio.c
 * @author Kang Shin Gu (indra1469@naver.com)
 * @brief GPIO 초기화 와 업데이트 관련
 * @version 1.0
 * @date 2024-05-25
 * 
 * @copyright Copyright (c) 2024
 */
#include "gpio.h"

#include <zephyr/shell/shell.h>

// for gpio control func rename
#define gpio_set gpio_pin_set_dt
#define gpio_get gpio_pin_get_dt
#define gpio_tgl gpio_pin_toggle_dt

// for logging
LOG_MODULE_DECLARE(my_module);

// for thread
K_THREAD_STACK_DEFINE(thread_stack_area_gpio_0, 256);
K_THREAD_STACK_DEFINE(thread_stack_area_gpio_1, 512);
static struct k_thread thread_data_gpio_0;
static struct k_thread thread_data_gpio_1;

// for Status Led
static LEDstatus isSetting = LEDstatus_isBlink;

// for keyStatus

#define KEY_STATUS_MSG_QUEUE_MAX_CNT 4

K_MSGQ_DEFINE(key_status_msg_queue,
			  sizeof(key_status_msg_data),
			  KEY_STATUS_MSG_QUEUE_MAX_CNT,
			  4);

/**
 * ------------ define gpioID -----------------
*/
#define GPIO_SPEC_AND_COMMA(node_id) GPIO_DT_SPEC_GET(node_id, gpios),

#define LED0_NODE DT_ALIAS(led0)
static const struct gpio_dt_spec led0 = GPIO_DT_SPEC_GET(LED0_NODE, gpios);

static const struct gpio_dt_spec btnpwr[] = {
    GPIO_DT_SPEC_GET(DT_NODELABEL(pins), btnpwr_0_gpios),
    GPIO_DT_SPEC_GET(DT_NODELABEL(pins), btnpwr_1_gpios),
    GPIO_DT_SPEC_GET(DT_NODELABEL(pins), btnpwr_2_gpios),
    GPIO_DT_SPEC_GET(DT_NODELABEL(pins), btnpwr_3_gpios),
};

static const struct gpio_dt_spec btnsens[] = {
    GPIO_DT_SPEC_GET(DT_NODELABEL(btn_0), gpios),
    GPIO_DT_SPEC_GET(DT_NODELABEL(btn_1), gpios),
    GPIO_DT_SPEC_GET(DT_NODELABEL(btn_2), gpios),
    GPIO_DT_SPEC_GET(DT_NODELABEL(btn_3), gpios),
};

/**
 * ------------ define gpioID end -----------------
*/

/**
 * @brief 준비 + 초기화
 * 
 * @param spec gpioID (GPIO_DT_SPEC_GET을 통해 얻은 ID)
 * @param extra_flags 추가할 GPIO속성 (aleady setted ACTIVE)
 * @return int 
 */
static int pin_init(const struct gpio_dt_spec *spec, gpio_flags_t extra_flags)
{
	if (!gpio_is_ready_dt(spec))
	{
		return -1;
	}

	return gpio_pin_configure_dt(spec, extra_flags);
}
int gpio_init(void)
{
	int ret = 0;
	ret = pin_init(&led0, GPIO_OUTPUT_INACTIVE);
	if (ret < 0)
	{
		return -1;
	}

	for (int i = 0; i < ARRAY_SIZE(btnpwr); i++)
	{
		// ret = pin_init(&btnpwr[i], GPIO_OUTPUT_ACTIVE);
		ret = pin_init(&btnpwr[i], GPIO_OUTPUT_INACTIVE);
		if (ret < 0)
		{
			return -1;
		}
	}

	for (int i = 0; i < ARRAY_SIZE(btnsens); i++)
	{
		ret = pin_init(&btnsens[i], GPIO_INPUT);
		if (ret < 0)
		{
			return -1;
		}
	}

	return 0;
}

static void thread_LedUpdate(void *arg1, void *arg2, void *arg3)
{
    // arg1, arg2, arg3 사용하지 않음을 명시
    (void)arg1;
    (void)arg2;
    (void)arg3;

	int ret = 0;
	while (true)
	{
		if (isSetting == LEDstatus_isBlink)
		{
			ret = gpio_tgl(&led0);
			if (ret < 0)
				return;
			k_msleep(250);
		}
		else
		{
			k_msleep(10);
		}
	}
}

/**
 * @brief 키보드 입력 체크(쓰레드)
 * 
 * @param arg1 no use
 * @param arg2 no use
 * @param arg3 no use
 */
static void thread_KeyInputUpdate(void *arg1, void *arg2, void *arg3)
{
	// arg1, arg2, arg3 사용하지 않음을 명시
	(void)arg1;
	(void)arg2;
	(void)arg3;

	uint16_t callcnt = 0;
	uint8_t rowIdx = 0;
	int ret = 0;

	while (true)
	{
		// 메시지 큐 확인
		if (k_msgq_num_free_get(&key_status_msg_queue) == 0)
		{
			// 메시지 큐가 가득 찼을 경우

			// option1. 모든 메시지를 비우기
			k_msgq_purge(&key_status_msg_queue);

			// option2. 메시지 1개 버리기
			// key_status_msg_data msg_data_discard;
			// k_msgq_get(&key_status_msg_queue, &msg_data_discard, K_NO_WAIT);
		}

		for (rowIdx = 0; rowIdx < 4; rowIdx++)
		{

			// 체크할 행 지정
			{
				ret = gpio_set(&btnpwr[rowIdx], 1);
				if (ret != RESERT_OK)
				{
					printk("Err. [thread_KeyInputUpdate] gpio_set\n");
					return;
				}
			}
			k_msleep(2);

			// GPIO Input(키입력) 체크
			{
				// printk("btnsens [%d] %d %d %d %d\n", rowIdx, gpio_get(&btnsens[0]), gpio_get(&btnsens[1]), gpio_get(&btnsens[2]), gpio_get(&btnsens[3]));
				key_status_msg_data msg_data;
				msg_data.rowIdx = rowIdx;
				for (size_t i = 0; i < 4; i++)
				{
					msg_data.colKeyInput[i] = gpio_get(&btnsens[i]);
				}

				// 메시지 발송
				ret = k_msgq_put(&key_status_msg_queue, &msg_data, K_NO_WAIT);
				if (ret != RESERT_OK)
				{
					printk("Err. [thread_KeyInputUpdate] k_msgq_put\n");
					return;
				}
			}
			k_msleep(2);

			// GPIO 초기화
			{
				ret = gpio_set(&btnpwr[rowIdx], 0);
				if (ret != RESERT_OK)
				{
					printk("Err. [thread_KeyInputUpdate] gpio_set\n");
					return;
				}
			}

			++callcnt;
			k_msleep(6);
		}
	}
}

int gpio_thread_start(void)
{
	k_thread_create(&thread_data_gpio_0, thread_stack_area_gpio_0,
					K_THREAD_STACK_SIZEOF(thread_stack_area_gpio_0),
					thread_LedUpdate,
					NULL, NULL, NULL,
					7, 0, K_NO_WAIT);
					
	k_thread_create(&thread_data_gpio_1, thread_stack_area_gpio_1,
					K_THREAD_STACK_SIZEOF(thread_stack_area_gpio_1),
					thread_KeyInputUpdate,
					NULL, NULL, NULL,
					3, 0, K_NO_WAIT);

    k_thread_start(&thread_data_gpio_0);
    k_thread_start(&thread_data_gpio_1);

	return 0;
}

struct k_msgq *get_key_status_msg_queue_ptr(void)
{
	return &key_status_msg_queue;
}

int gpio_setStatusLed(LEDstatus setting)
{
	switch (setting)
	{
	case LEDstatus_isOff:
	case LEDstatus_isOn:
		isSetting = setting;
		return gpio_set(&led0, isSetting);
		break;

	case LEDstatus_isBlink:
		isSetting = setting;
		return RESERT_OK;
		break;
	}

	return RESERT_ERR;
}
```

## src/gpio.h
```c
#ifndef GPIO_H
#define GPIO_H

#include "include.h"

#include <zephyr/drivers/gpio.h>

struct key_status_msg_data_t
{
	uint8_t rowIdx;
	bool colKeyInput[4];
}typedef key_status_msg_data;

enum LEDstatus_e
{
	LEDstatus_isOff = 0,
	LEDstatus_isOn,
	LEDstatus_isBlink,
} typedef LEDstatus;


int gpio_init(void);
int gpio_thread_start(void);
struct k_msgq *get_key_status_msg_queue_ptr();
int gpio_setStatusLed(LEDstatus set);

#endif
```

## src/hid_usages.h
```c
/**
 * @file hid_usages.h
 * @author Kang Shin Gu (indra1469@naver.com)
 * @brief HID Keyboard Usages
 * 
 * check HID Usage Tables.
 * https://usb.org/document-library/hid-usage-tables-15
 * 
 * @version 1.0
 * @date 2024-05-25
 * 
 * @copyright Copyright (c) 2024
 * 
 */

#ifndef HID_USAGES_H
#define HID_USAGES_H

#define HID_KEY_MOD_LCTRL  0x01
#define HID_KEY_MOD_LSHIFT 0x02
#define HID_KEY_MOD_LALT   0x04
#define HID_KEY_MOD_LMETA  0x08
#define HID_KEY_MOD_RCTRL  0x10
#define HID_KEY_MOD_RSHIFT 0x20
#define HID_KEY_MOD_RALT   0x40
#define HID_KEY_MOD_RMETA  0x80

/**
 * Scan codes - last N slots in the HID report (usually 6).
 * 0x00 if no key pressed.
 * 
 * If more than N keys are pressed, the HID reports 
 * KEY_ERR_OVF in all slots to indicate this condition.
 */

#define HID_KEY_NONE 0x00 // No key pressed
#define HID_KEY_ERR_OVF 0x01 //  Keyboard Error Roll Over - used for all slots if too many keys are pressed ("Phantom key")
// 0x02 //  Keyboard POST Fail
// 0x03 //  Keyboard Error Undefined
#define HID_KEY_A 0x04 // Keyboard a and A
#define HID_KEY_B 0x05 // Keyboard b and B
#define HID_KEY_C 0x06 // Keyboard c and C
#define HID_KEY_D 0x07 // Keyboard d and D
#define HID_KEY_E 0x08 // Keyboard e and E
#define HID_KEY_F 0x09 // Keyboard f and F
#define HID_KEY_G 0x0a // Keyboard g and G
#define HID_KEY_H 0x0b // Keyboard h and H
#define HID_KEY_I 0x0c // Keyboard i and I
#define HID_KEY_J 0x0d // Keyboard j and J
#define HID_KEY_K 0x0e // Keyboard k and K
#define HID_KEY_L 0x0f // Keyboard l and L
#define HID_KEY_M 0x10 // Keyboard m and M
#define HID_KEY_N 0x11 // Keyboard n and N
#define HID_KEY_O 0x12 // Keyboard o and O
#define HID_KEY_P 0x13 // Keyboard p and P
#define HID_KEY_Q 0x14 // Keyboard q and Q
#define HID_KEY_R 0x15 // Keyboard r and R
#define HID_KEY_S 0x16 // Keyboard s and S
#define HID_KEY_T 0x17 // Keyboard t and T
#define HID_KEY_U 0x18 // Keyboard u and U
#define HID_KEY_V 0x19 // Keyboard v and V
#define HID_KEY_W 0x1a // Keyboard w and W
#define HID_KEY_X 0x1b // Keyboard x and X
#define HID_KEY_Y 0x1c // Keyboard y and Y
#define HID_KEY_Z 0x1d // Keyboard z and Z

#define HID_KEY_1 0x1e // Keyboard 1 and !
#define HID_KEY_2 0x1f // Keyboard 2 and @
#define HID_KEY_3 0x20 // Keyboard 3 and #
#define HID_KEY_4 0x21 // Keyboard 4 and $
#define HID_KEY_5 0x22 // Keyboard 5 and %
#define HID_KEY_6 0x23 // Keyboard 6 and ^
#define HID_KEY_7 0x24 // Keyboard 7 and &
#define HID_KEY_8 0x25 // Keyboard 8 and *
#define HID_KEY_9 0x26 // Keyboard 9 and (
#define HID_KEY_0 0x27 // Keyboard 0 and )

#define HID_KEY_ENTER 0x28 // Keyboard Return (ENTER)
#define HID_KEY_ESC 0x29 // Keyboard ESCAPE
#define HID_KEY_BACKSPACE 0x2a // Keyboard DELETE (Backspace)
#define HID_KEY_TAB 0x2b // Keyboard Tab
#define HID_KEY_SPACE 0x2c // Keyboard Spacebar
#define HID_KEY_MINUS 0x2d // Keyboard - and _
#define HID_KEY_EQUAL 0x2e // Keyboard = and +
#define HID_KEY_LEFTBRACE 0x2f // Keyboard [ and {
#define HID_KEY_RIGHTBRACE 0x30 // Keyboard ] and }
#define HID_KEY_BACKSLASH 0x31 // Keyboard \ and |
#define HID_KEY_HASHTILDE 0x32 // Keyboard Non-US # and ~
#define HID_KEY_SEMICOLON 0x33 // Keyboard ; and :
#define HID_KEY_APOSTROPHE 0x34 // Keyboard ' and "
#define HID_KEY_GRAVE 0x35 // Keyboard ` and ~
#define HID_KEY_COMMA 0x36 // Keyboard , and <
#define HID_KEY_DOT 0x37 // Keyboard . and >
#define HID_KEY_SLASH 0x38 // Keyboard / and ?
#define HID_KEY_CAPSLOCK 0x39 // Keyboard Caps Lock

#define HID_KEY_F1 0x3a // Keyboard F1
#define HID_KEY_F2 0x3b // Keyboard F2
#define HID_KEY_F3 0x3c // Keyboard F3
#define HID_KEY_F4 0x3d // Keyboard F4
#define HID_KEY_F5 0x3e // Keyboard F5
#define HID_KEY_F6 0x3f // Keyboard F6
#define HID_KEY_F7 0x40 // Keyboard F7
#define HID_KEY_F8 0x41 // Keyboard F8
#define HID_KEY_F9 0x42 // Keyboard F9
#define HID_KEY_F10 0x43 // Keyboard F10
#define HID_KEY_F11 0x44 // Keyboard F11
#define HID_KEY_F12 0x45 // Keyboard F12

#define HID_KEY_SYSRQ 0x46 // Keyboard Print Screen
#define HID_KEY_SCROLLLOCK 0x47 // Keyboard Scroll Lock
#define HID_KEY_PAUSE 0x48 // Keyboard Pause
#define HID_KEY_INSERT 0x49 // Keyboard Insert
#define HID_KEY_HOME 0x4a // Keyboard Home
#define HID_KEY_PAGEUP 0x4b // Keyboard Page Up
#define HID_KEY_DELETE 0x4c // Keyboard Delete Forward
#define HID_KEY_END 0x4d // Keyboard End
#define HID_KEY_PAGEDOWN 0x4e // Keyboard Page Down
#define HID_KEY_RIGHT 0x4f // Keyboard Right Arrow
#define HID_KEY_LEFT 0x50 // Keyboard Left Arrow
#define HID_KEY_DOWN 0x51 // Keyboard Down Arrow
#define HID_KEY_UP 0x52 // Keyboard Up Arrow

#define HID_KEY_NUMLOCK 0x53 // Keyboard Num Lock and Clear
#define HID_KEY_KPSLASH 0x54 // Keypad /
#define HID_KEY_KPASTERISK 0x55 // Keypad *
#define HID_KEY_KPMINUS 0x56 // Keypad -
#define HID_KEY_KPPLUS 0x57 // Keypad +
#define HID_KEY_KPENTER 0x58 // Keypad ENTER
#define HID_KEY_KP1 0x59 // Keypad 1 and End
#define HID_KEY_KP2 0x5a // Keypad 2 and Down Arrow
#define HID_KEY_KP3 0x5b // Keypad 3 and PageDn
#define HID_KEY_KP4 0x5c // Keypad 4 and Left Arrow
#define HID_KEY_KP5 0x5d // Keypad 5
#define HID_KEY_KP6 0x5e // Keypad 6 and Right Arrow
#define HID_KEY_KP7 0x5f // Keypad 7 and Home
#define HID_KEY_KP8 0x60 // Keypad 8 and Up Arrow
#define HID_KEY_KP9 0x61 // Keypad 9 and Page Up
#define HID_KEY_KP0 0x62 // Keypad 0 and Insert
#define HID_KEY_KPDOT 0x63 // Keypad . and Delete

#define HID_KEY_102ND 0x64 // Keyboard Non-US \ and |
#define HID_KEY_COMPOSE 0x65 // Keyboard Application
#define HID_KEY_POWER 0x66 // Keyboard Power
#define HID_KEY_KPEQUAL 0x67 // Keypad =

#define HID_KEY_F13 0x68 // Keyboard F13
#define HID_KEY_F14 0x69 // Keyboard F14
#define HID_KEY_F15 0x6a // Keyboard F15
#define HID_KEY_F16 0x6b // Keyboard F16
#define HID_KEY_F17 0x6c // Keyboard F17
#define HID_KEY_F18 0x6d // Keyboard F18
#define HID_KEY_F19 0x6e // Keyboard F19
#define HID_KEY_F20 0x6f // Keyboard F20
#define HID_KEY_F21 0x70 // Keyboard F21
#define HID_KEY_F22 0x71 // Keyboard F22
#define HID_KEY_F23 0x72 // Keyboard F23
#define HID_KEY_F24 0x73 // Keyboard F24

#define HID_KEY_OPEN 0x74 // Keyboard Execute
#define HID_KEY_HELP 0x75 // Keyboard Help
#define HID_KEY_PROPS 0x76 // Keyboard Menu
#define HID_KEY_FRONT 0x77 // Keyboard Select
#define HID_KEY_STOP 0x78 // Keyboard Stop
#define HID_KEY_AGAIN 0x79 // Keyboard Again
#define HID_KEY_UNDO 0x7a // Keyboard Undo
#define HID_KEY_CUT 0x7b // Keyboard Cut
#define HID_KEY_COPY 0x7c // Keyboard Copy
#define HID_KEY_PASTE 0x7d // Keyboard Paste
#define HID_KEY_FIND 0x7e // Keyboard Find
#define HID_KEY_MUTE 0x7f // Keyboard Mute
#define HID_KEY_VOLUMEUP 0x80 // Keyboard Volume Up
#define HID_KEY_VOLUMEDOWN 0x81 // Keyboard Volume Down
// 0x82  Keyboard Locking Caps Lock
// 0x83  Keyboard Locking Num Lock
// 0x84  Keyboard Locking Scroll Lock
#define HID_KEY_KPCOMMA 0x85 // Keypad Comma
// 0x86  Keypad Equal Sign
#define HID_KEY_RO 0x87 // Keyboard International1
#define HID_KEY_KATAKANAHIRAGANA 0x88 // Keyboard International2
#define HID_KEY_YEN 0x89 // Keyboard International3
#define HID_KEY_HENKAN 0x8a // Keyboard International4
#define HID_KEY_MUHENKAN 0x8b // Keyboard International5
#define HID_KEY_KPJPCOMMA 0x8c // Keyboard International6
// 0x8d  Keyboard International7
// 0x8e  Keyboard International8
// 0x8f  Keyboard International9
#define HID_KEY_HANGEUL 0x90 // Keyboard LANG1
#define HID_KEY_HANJA 0x91 // Keyboard LANG2
#define HID_KEY_KATAKANA 0x92 // Keyboard LANG3
#define HID_KEY_HIRAGANA 0x93 // Keyboard LANG4
#define HID_KEY_ZENKAKUHANKAKU 0x94 // Keyboard LANG5

#define HID_KEY_KPLEFTPAREN 0xb6 // Keypad (
#define HID_KEY_KPRIGHTPAREN 0xb7 // Keypad )


#define HID_KEY_LEFTCTRL 0xe0 // Keyboard Left Control
#define HID_KEY_LEFTSHIFT 0xe1 // Keyboard Left Shift
#define HID_KEY_LEFTALT 0xe2 // Keyboard Left Alt
#define HID_KEY_LEFTMETA 0xe3 // Keyboard Left GUI
#define HID_KEY_RIGHTCTRL 0xe4 // Keyboard Right Control
#define HID_KEY_RIGHTSHIFT 0xe5 // Keyboard Right Shift
#define HID_KEY_RIGHTALT 0xe6 // Keyboard Right Alt
#define HID_KEY_RIGHTMETA 0xe7 // Keyboard Right GUI

#define HID_KEY_MEDIA_PLAYPAUSE 0xe8
#define HID_KEY_MEDIA_STOPCD 0xe9
#define HID_KEY_MEDIA_PREVIOUSSONG 0xea
#define HID_KEY_MEDIA_NEXTSONG 0xeb
#define HID_KEY_MEDIA_EJECTCD 0xec
#define HID_KEY_MEDIA_VOLUMEUP 0xed
#define HID_KEY_MEDIA_VOLUMEDOWN 0xee
#define HID_KEY_MEDIA_MUTE 0xef
#define HID_KEY_MEDIA_WWW 0xf0
#define HID_KEY_MEDIA_BACK 0xf1
#define HID_KEY_MEDIA_FORWARD 0xf2
#define HID_KEY_MEDIA_STOP 0xf3
#define HID_KEY_MEDIA_FIND 0xf4
#define HID_KEY_MEDIA_SCROLLUP 0xf5
#define HID_KEY_MEDIA_SCROLLDOWN 0xf6
#define HID_KEY_MEDIA_EDIT 0xf7
#define HID_KEY_MEDIA_SLEEP 0xf8
#define HID_KEY_MEDIA_COFFEE 0xf9
#define HID_KEY_MEDIA_REFRESH 0xfa
#define HID_KEY_MEDIA_CALC 0xfb

#endif
```

## src/include.h
```c
#ifndef INCLDUE_H_
#define INCLDUE_H_

#define RESERT_OK 0
#define RESERT_ERR -1

#include <zephyr/kernel.h>

#include <zephyr/logging/log.h>

#endif
```
